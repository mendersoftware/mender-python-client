## tests/integration/yocto/meta-mender-python-client/conf/layer.conf
```bitbake
# We have a conf and classes directory, add to BBPATH
BBPATH .= ":${LAYERDIR}"

# We have recipes-* directories, add to BBFILES
BBFILES += "${LAYERDIR}/recipes-*/*/*.bb \
            ${LAYERDIR}/recipes-*/*/*.bbappend"

BBFILE_COLLECTIONS += "mender-python-client"
BBFILE_PATTERN_mender-python-client = "^${LAYERDIR}/"
BBFILE_PRIORITY_mender-python-client = "6"

LAYERDEPENDS_mender-python-client = "core"
LAYERSERIES_COMPAT_mender-python-client = "dunfell"
```
